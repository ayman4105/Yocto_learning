## session3/meta-main/conf/layer.conf
```bitbake
# We have a conf and classes directory, add to BBPATH
BBPATH .= ":${LAYERDIR}"

# We have recipes-* directories, add to BBFILES
BBFILES += "${LAYERDIR}/recipes-*/*/*.bb \
            ${LAYERDIR}/recipes-*/*/*.bbappend"

BBFILE_COLLECTIONS += "meta-main"
BBFILE_PATTERN_meta-main = "^${LAYERDIR}/"
BBFILE_PRIORITY_meta-main = "6"

LAYERDEPENDS_meta-main = "core"
LAYERSERIES_COMPAT_meta-main = "scarthgap"
```
